## config/west.yml
```yaml
manifest:
  remotes:
    - name: zmkfirmware
      url-base: https://github.com/zmkfirmware
    - name: zmksuspend
      url-base: https://github.com/nahtonaj
  projects:
    - name: zmk
      remote: zmksuspend
      revision: main
      import: app/west.yml
  self:
    path: config
```
